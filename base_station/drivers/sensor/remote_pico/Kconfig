## base_station/drivers/sensor/remote_pico/Kconfig
```kconfig
config REMOTE_PICO
    bool "Remote Pico virtual sensor"
    default y
    depends on SENSOR
    depends on I2C
    depends on DT_HAS_VND_REMOTE_PICO_ENABLED
```

## west.yml
```yaml
manifest:
  version: "0.13"

  remotes:
    - name: zephyrproject
      url-base: https://github.com/zephyrproject-rtos

  projects:
    - name: zephyr
      remote: zephyrproject
      revision: v4.2.1
      path: zephyr
      import: true
```
